## main/Kconfig.projbuild
```kconfig
menu "Custom Configuration"
	choice PRODUCTION_MODE
        prompt "Code objetive"
        default CONFIG_MODE
        help
            Choose what is the objective of deployment of the compiled code 

        config CONFIG_MODE
            bool "Config RTU"

        config PRODUCTION_PATCH
            bool "General patch"
    endchoice
    
	choice HARDWARE
        prompt "Code objetive"
        default TEST
        help
            Choose the target hardware

        config TEST
            bool "TEST on dev boards"

        config PRODUCTION
            bool "Deploy on spec PCB"
    endchoice
    config PULSE_PERIPHERAL
        bool "Pulse counter peripheral available"
        default "n"
        help
            When this is not enable the task that counts pulse will be unavailable
   
    config SLAVE_MODBUS
        bool "Slave Modbus active"
        default "n"
        help
            This functions provides a slave Modbus RTU functionality through RS485
   
    config MASTER_MODBUS
        bool "Master Modbus active"
        default "n"
        help
            This functions provides a master Modbus RTU functionality through RS485
   
    config LORA
        bool "LoRa connected"
        default "n"
        help
            This functions provides serial communication to a LoRa
    
    config ID
        int "node identifier"
        range 1 255
        default 255
        help
            unique network identifier
    config SLAVES
        int "Number of slaves"
        range 0 255
        default 0
        help
            number of slaves to poll
    config IMPULSE_CONVERSION
        int "Conversion factor imp/kWh"
        range 1 100000
        default 1600
        help
            Conversion ratio  between impulses and kWh
    config INITIAL_ENERGY
        int "Initial energy kWh w/o dot 2 decimals"
        range 0 100000000
        default 0
        help
            Initial energy displayed in the meter. 
            e.g.: 754.32 kWh displayed would be 75432 at the input
            Firmware will convert it. It has 2 decimals maximum precision.
	menu "OTA config"
		config OTA
			bool "OTA available"
			default "n"
			help
				Activate OTA updates
		if OTA		
			config FIRMWARE_UPGRADE_URL
		        string "firmware upgrade url endpoint"
		        default "https://192.168.0.3:8070/hello-world.bin"
		        help
		            URL of server which hosts the firmware
		            image.
	            
			config SKIP_COMMON_NAME_CHECK
		        bool "Skip server certificate CN fieldcheck"
		        default n
		        help
           			 This allows you to skip the validation of OTA server certificate CN field.
		    config FIRMWARE_UPGRADE_URL_FROM_STDIN
		        bool
		        default y if FIRMWARE_UPGRADE_URL = "FROM_STDIN"  
		        help 
		        	None
		    config WIFI_SSID
	            string "WiFi SSID"
	            default "myssid"
	            help
	                SSID (network name) for the example to connect to.

	        config WIFI_PASSWORD
	            string "WiFi Password"
	            default "mypassword"
	            help
	                WiFi password (WPA or WPA2) for the example to use.
	                Can be left blank if the network has no security set.
	                
		    config CONNECT_IPV6
		        bool "Obtain IPv6 link-local address"
		        default y
		        help
		            By default, examples will wait until IPv4 and IPv6 addresses are obtained.
		            Disable this option if the network does not support IPv6.   
		endif
	endmenu
	
	config CIPHER
		bool "Cipher LoRa data"
		default n
		help 
			When enable only payload data will be cipher using AES
endmenu
```
